/*
(c)SplawPlay 2016-2018
*/
#define Belectricidad 9
#define pinldr A0
#define ledshuerto 8
#define ledsprincipales 7

bool ledhon;
void setup() 
{
  pinMode(Belectricidad, OUTPUT);
  pinMode(ledshuerto, OUTPUT);
  pinMode(pinldr, INPUT);
  pinMode(ledsprincipales, OUTPUT);
  digitalWrite(Belectricidad, HIGH);
  Serial.begin(9600);
}

void loop() 
{
  int state;
  bool huertostate = true;
  bool ledspon = false;
  if(Serial.available() > 0)
  {
    state = Serial.read();
  
    switch(state)
    {
      case'1': //Activar huerto / desactivar huerto
        if(huertostate) 
        huertostate = false;
        else
        huertostate = true;
      break;
      case '2': // Activar/Desactivar Luces Huerto
        if(huertostate)
        {
          Serial.print("ERROR al encender las luces, sistema del huerto: ON");
        }
        else
        {
          if(ledhon)
          {
            digitalWrite(ledshuerto, LOW);
            ledhon = false;
            Serial.print("Luces del huerto apagadas");
          }
          else
          {
            digitalWrite(ledshuerto, HIGH);
            ledhon = true;
            Serial.print("Luces del huerto encendidas");
          }
        }
      break;
      case'3': //Activar luces
        if(ledspon)
        {
          digitalWrite(ledsprincipales, LOW);
          Serial.print("Luces generales apagadas");
          ledspon = true;
        }
        else
        {
          digitalWrite(ledsprincipales, HIGH);
          Serial.print("Luces generales encendidas");
          ledspon = true;
        }
      break;
      default:
      
      break;
    }
  }
  huerto(huertostate);
}

void huerto(bool estado)
{
  if(estado)
  {
    int valorldr;
    valorldr = analogRead(pinldr);
    if(valorldr <= 150)
    {
      digitalWrite(ledshuerto, HIGH);
    }
    else if(valorldr > 150)
    {
      digitalWrite(ledshuerto, LOW);
    }
  }else
  {
    Serial.print("Error: Huerto DESACTIVADO");
  }
}
